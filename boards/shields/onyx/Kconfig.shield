## boards/shields/onyx/Kconfig.shield
```kconfig
config SHIELD_ONYX_LEFT
    def_bool $(shields_list_contains,onyx_left)

config SHIELD_ONYX_RIGHT
    def_bool $(shields_list_contains,onyx_right)
```
